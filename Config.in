## configs/raspberrypi4_64_gnuradio39_defconfig
```kconfig
BR2_aarch64=y
BR2_cortex_a72=y
BR2_ARM_FPU_VFPV4=y
BR2_TOOLCHAIN_BUILDROOT_GLIBC=y
BR2_PACKAGE_HOST_LINUX_HEADERS_CUSTOM_5_10=y
BR2_TOOLCHAIN_BUILDROOT_CXX=y
BR2_TOOLCHAIN_BUILDROOT_FORTRAN=y
BR2_ROOTFS_DEVICE_CREATION_DYNAMIC_EUDEV=y
BR2_TARGET_GENERIC_ROOT_PASSWD="root"
BR2_SYSTEM_DHCP="eth0"
BR2_ROOTFS_POST_BUILD_SCRIPT="board/raspberrypi4-64/post-build.sh"
BR2_ROOTFS_POST_IMAGE_SCRIPT="board/raspberrypi4-64/post-image.sh"
BR2_ROOTFS_POST_SCRIPT_ARGS="--add-miniuart-bt-overlay --aarch64"
BR2_LINUX_KERNEL=y
BR2_LINUX_KERNEL_CUSTOM_TARBALL=y
BR2_LINUX_KERNEL_CUSTOM_TARBALL_LOCATION="$(call github,raspberrypi,linux,0b54dbda3cca2beb51e236a25738784e90853b64)/linux-0b54dbda3cca2beb51e236a25738784e90853b64.tar.gz"
BR2_LINUX_KERNEL_DEFCONFIG="bcm2711"
BR2_LINUX_KERNEL_DTS_SUPPORT=y
BR2_LINUX_KERNEL_INTREE_DTS_NAME="broadcom/bcm2711-rpi-4-b"
BR2_LINUX_KERNEL_NEEDS_HOST_OPENSSL=y
BR2_PACKAGE_ALSA_UTILS=y
BR2_PACKAGE_ALSA_UTILS_APLAY=y
BR2_PACKAGE_ALSA_UTILS_SPEAKER_TEST=y
BR2_PACKAGE_PYTHON3=y
# BR2_PACKAGE_LIBRTLSDR_ZEROCOPY is not set
BR2_PACKAGE_ARMADILLO=y
BR2_PACKAGE_OPENBLAS=y
BR2_PACKAGE_GNURADIO39=y
BR2_PACKAGE_GNURADIO39_AUDIO=y
BR2_PACKAGE_GNURADIO39_PYTHON=y
BR2_PACKAGE_GNURADIO39_ZEROMQ=y
BR2_PACKAGE_GNURADIO39_QTGUI=y
BR2_PACKAGE_GNURADIO39_ANALOG=y
BR2_PACKAGE_GNURADIO39_UHD=y
BR2_PACKAGE_GR_OSMOSDR=y
BR2_PACKAGE_GR_OSMOSDR_PYTHON=y
BR2_PACKAGE_GR_OSMOSDR_RTLSDR=y
BR2_PACKAGE_DROPBEAR=y
BR2_PACKAGE_SCREEN=y
BR2_TARGET_ROOTFS_EXT2=y
BR2_TARGET_ROOTFS_EXT2_4=y
BR2_TARGET_ROOTFS_EXT2_SIZE="520M"
# BR2_TARGET_ROOTFS_TAR is not set
BR2_PACKAGE_HOST_DOSFSTOOLS=y
BR2_PACKAGE_HOST_GENIMAGE=y
BR2_PACKAGE_HOST_MTOOLS=y
BR2_PACKAGE_UHD=y
BR2_PACKAGE_UHD_B200=y
BR2_PACKAGE_VXI11=y

BR2_PACKAGE_RPI_FIRMWARE=y
BR2_PACKAGE_RPI_FIRMWARE_VARIANT_PI4=y
BR2_PACKAGE_RPI_FIRMWARE_CONFIG_FILE="board/raspberrypi4-64/config_4_64bit.txt"
BR2_PACKAGE_RPI_FIRMWARE_DEFAULT=y
BR2_PACKAGE_RPI_FIRMWARE_BOOT="4"
```

## configs/raspberrypicm4_64_gnuradio_defconfig
```kconfig
BR2_aarch64=y
BR2_cortex_a72=y
BR2_ARM_FPU_VFPV4=y
BR2_CCACHE=y
BR2_GLOBAL_PATCH_DIR="$(BR2_EXTERNAL_OSCBR2EXTERNAL_PATH)/board/patches"
BR2_TOOLCHAIN_BUILDROOT_GLIBC=y
BR2_TOOLCHAIN_BUILDROOT_CXX=y
BR2_TOOLCHAIN_BUILDROOT_FORTRAN=y
BR2_ROOTFS_DEVICE_CREATION_DYNAMIC_EUDEV=y
BR2_TARGET_GENERIC_ROOT_PASSWD="root"
BR2_ROOTFS_OVERLAY="$(BR2_EXTERNAL_OSCBR2EXTERNAL_PATH)/board/raspberrypicm4-64/overlay"
BR2_ROOTFS_POST_BUILD_SCRIPT="$(BR2_EXTERNAL_OSCBR2EXTERNAL_PATH)/board/raspberrypicm4-64/post-build.sh"
BR2_ROOTFS_POST_IMAGE_SCRIPT="$(BR2_EXTERNAL_OSCBR2EXTERNAL_PATH)/board/raspberrypicm4-64/post-image.sh"
BR2_ROOTFS_POST_SCRIPT_ARGS="--add-miniuart-bt-overlay --aarch64 --pcie-32bit-dma"
BR2_LINUX_KERNEL=y
BR2_LINUX_KERNEL_CUSTOM_TARBALL=y
BR2_LINUX_KERNEL_CUSTOM_TARBALL_LOCATION="$(call github,raspberrypi,linux,00636384bb556720e69b5225717a5fde1257a234)/linux-00636384bb556720e69b5225717a5fde1257a234.tar.gz"
BR2_LINUX_KERNEL_USE_CUSTOM_CONFIG=y
BR2_LINUX_KERNEL_CUSTOM_CONFIG_FILE="$(BR2_EXTERNAL_OSCBR2EXTERNAL_PATH)/board/raspberrypicm4-64/linux-5.12_defconfig"
BR2_LINUX_KERNEL_DTS_SUPPORT=y
BR2_LINUX_KERNEL_INTREE_DTS_NAME="broadcom/bcm2711-rpi-cm4"
BR2_LINUX_KERNEL_NEEDS_HOST_OPENSSL=y
BR2_PACKAGE_LINUX_TOOLS_PCI=y
BR2_PACKAGE_RPI_FIRMWARE=y
BR2_PACKAGE_RPI_FIRMWARE_VARIANT_PI4=y
BR2_PACKAGE_HWDATA=y
BR2_PACKAGE_HWDATA_IAB_OUI_TXT=y
BR2_PACKAGE_HWDATA_PNP_IDS=y
BR2_PACKAGE_PCIUTILS=y
BR2_PACKAGE_PYTHON3=y
BR2_PACKAGE_LIBPCIACCESS=y
# BR2_PACKAGE_LIBRTLSDR_ZEROCOPY is not set
BR2_PACKAGE_ARMADILLO=y
BR2_PACKAGE_OPENBLAS=y
BR2_PACKAGE_GNURADIO=y
BR2_PACKAGE_GNURADIO_PYTHON=y
BR2_PACKAGE_GR_OSMOSDR_PYTHON=y
BR2_PACKAGE_GR_OSMOSDR_RTLSDR=y
BR2_PACKAGE_GR_OSMOSDR_XTRX=y
BR2_PACKAGE_HAVEGED=y
BR2_PACKAGE_DROPBEAR=y
BR2_PACKAGE_SCREEN=y
BR2_TARGET_ROOTFS_EXT2=y
BR2_TARGET_ROOTFS_EXT2_4=y
BR2_TARGET_ROOTFS_EXT2_SIZE="820M"
# BR2_TARGET_ROOTFS_TAR is not set
BR2_PACKAGE_HOST_DOSFSTOOLS=y
BR2_PACKAGE_HOST_GENIMAGE=y
BR2_PACKAGE_HOST_MTOOLS=y
BR2_LINUX_KERNEL_EXT_XTRX_LINUX_PCIE_DRV=y
BR2_PACKAGE_GNSS_SDR=y
BR2_PACKAGE_GNSS_SDR_OSMOSDR=y
BR2_PACKAGE_LIBLMS7002M=y
BR2_PACKAGE_LIBUSB3380=y
BR2_PACKAGE_LIBXTRX=y
```

## configs/rockpro64_gnuradio_defconfig
```kconfig
BR2_aarch64=y
BR2_cortex_a72_a53=y
BR2_CCACHE=y
BR2_GLOBAL_PATCH_DIR="$(BR2_EXTERNAL_OSCBR2EXTERNAL_PATH)/board/rockpro64/patches"
BR2_TOOLCHAIN_BUILDROOT_GLIBC=y
BR2_TOOLCHAIN_BUILDROOT_CXX=y
BR2_TOOLCHAIN_BUILDROOT_FORTRAN=y
BR2_TARGET_GENERIC_HOSTNAME="rockpro64"
BR2_TARGET_GENERIC_ISSUE="Welcome to ROCKPRO64"
BR2_ROOTFS_DEVICE_CREATION_DYNAMIC_EUDEV=y
BR2_TARGET_GENERIC_ROOT_PASSWD="root"
BR2_ROOTFS_OVERLAY="$(BR2_EXTERNAL_OSCBR2EXTERNAL_PATH)/board/rockpro64/overlay"
BR2_ROOTFS_POST_BUILD_SCRIPT="$(BR2_EXTERNAL_OSCBR2EXTERNAL_PATH)/board/rockpro64/post-build.sh"
BR2_ROOTFS_POST_IMAGE_SCRIPT="support/scripts/genimage.sh"
BR2_ROOTFS_POST_SCRIPT_ARGS="-c $(BR2_EXTERNAL_OSCBR2EXTERNAL_PATH)/board/rockpro64/genimage.cfg"
BR2_LINUX_KERNEL=y
BR2_LINUX_KERNEL_USE_CUSTOM_CONFIG=y
BR2_LINUX_KERNEL_CUSTOM_CONFIG_FILE="$(BR2_EXTERNAL_OSCBR2EXTERNAL_PATH)/board/rockpro64/linux-5.10_defconfig"
BR2_LINUX_KERNEL_DTS_SUPPORT=y
BR2_LINUX_KERNEL_INTREE_DTS_NAME="rockchip/rk3399-rockpro64-v2"
BR2_LINUX_KERNEL_NEEDS_HOST_OPENSSL=y
BR2_PACKAGE_LINUX_TOOLS_PCI=y
BR2_PACKAGE_HWDATA=y
BR2_PACKAGE_PCIUTILS=y
BR2_PACKAGE_PYTHON3=y
BR2_PACKAGE_LIBPCIACCESS=y
BR2_PACKAGE_ARMADILLO=y
BR2_PACKAGE_GNURADIO=y
BR2_PACKAGE_GNURADIO_PYTHON=y
BR2_PACKAGE_GNURADIO_UTILS=y
BR2_PACKAGE_GNURADIO_DIGITAL=y
BR2_PACKAGE_GR_OSMOSDR_PYTHON=y
BR2_PACKAGE_GR_OSMOSDR_RTLSDR=y
BR2_PACKAGE_GR_OSMOSDR_XTRX=y
BR2_PACKAGE_DROPBEAR=y
BR2_TARGET_ROOTFS_EXT2=y
BR2_TARGET_ROOTFS_EXT2_4=y
BR2_TARGET_ROOTFS_EXT2_SIZE="150M"
BR2_TARGET_ARM_TRUSTED_FIRMWARE=y
BR2_TARGET_ARM_TRUSTED_FIRMWARE_CUSTOM_GIT=y
BR2_TARGET_ARM_TRUSTED_FIRMWARE_CUSTOM_REPO_URL=" https://github.com/ARM-software/arm-trusted-firmware.git"
BR2_TARGET_ARM_TRUSTED_FIRMWARE_CUSTOM_REPO_VERSION="2773536b171ffdc460891d33b3347f9df313a5fc"
BR2_TARGET_ARM_TRUSTED_FIRMWARE_PLATFORM="rk3399"
BR2_TARGET_ARM_TRUSTED_FIRMWARE_IMAGES=""
BR2_TARGET_ARM_TRUSTED_FIRMWARE_NEEDS_ARM32_TOOLCHAIN=y
BR2_TARGET_UBOOT=y
BR2_TARGET_UBOOT_BOARD_DEFCONFIG="rockpro64-rk3399"
BR2_TARGET_UBOOT_CONFIG_FRAGMENT_FILES="$(BR2_EXTERNAL_OSCBR2EXTERNAL_PATH)/board/rockpro64/uboot-2020.10_fragment"
BR2_TARGET_UBOOT_NEEDS_DTC=y
BR2_TARGET_UBOOT_NEEDS_PYTHON3=y
BR2_TARGET_UBOOT_NEEDS_ATF_BL31=y
BR2_TARGET_UBOOT_NEEDS_ATF_BL31_ELF=y
BR2_TARGET_UBOOT_FORMAT_CUSTOM=y
BR2_TARGET_UBOOT_FORMAT_CUSTOM_NAME="u-boot.itb"
BR2_TARGET_UBOOT_SPL=y
BR2_TARGET_UBOOT_SPL_NAME="idbloader.img"
BR2_PACKAGE_HOST_DOSFSTOOLS=y
BR2_PACKAGE_HOST_GENIMAGE=y
BR2_PACKAGE_HOST_MTOOLS=y
BR2_PACKAGE_HOST_UBOOT_TOOLS=y
BR2_PACKAGE_GNSS_SDR=y
BR2_PACKAGE_GNSS_SDR_OSMOSDR=y
BR2_PACKAGE_LIBLMS7002M=y
BR2_PACKAGE_LIBUSB3380=y
BR2_PACKAGE_LIBXTRX=y
```

## package/adc-lib/Config.in
```kconfig
comment "adc-lib needs python3"
	depends on !BR2_PACKAGE_PYTHON3

comment "adc-lib needs host python3"
	depends on !BR2_PACKAGE_HOST_PYTHON3

config BR2_PACKAGE_ADC_LIB
	bool "adc-lib"
	depends on BR2_PACKAGE_HOST_PYTHON3
	depends on BR2_PACKAGE_PYTHON3
	select BR2_PACKAGE_FMC_ADC_100M
	help
	  This library provides a generic API for ADC devices, so that applications
	  can use this API to access any of the supported ADC boards.

	  https://ohwr.org/project/adc-lib
```

## package/cheby/Config.in.host
```kconfig
comment "cheby needs host python3"
	depends on !BR2_PACKAGE_HOST_PYTHON3

config BR2_PACKAGE_HOST_CHEBY
	bool "host cheby"
	depends on BR2_PACKAGE_PYTHON3
	select BR2_PACKAGE_HOST_PYTHON3_SETUPTOOLS
	select BR2_PACKAGE_HOST_PYTHON_PYYAML
	help
	  The Cheby project aims at defining a file format to describe the HW/SW
	  interface (the memory map), and a set of tools to generate HDL, drivers,
	  documentation... from these files.

	  https://gitlab.cern.ch/cohtdrivers/cheby
```

## package/faac/Config.in
```kconfig
config BR2_PACKAGE_FAAC
	bool "faac"
	help
	  FAAC library

	  https://sourceforge.net/projects/faac/files/
```

## package/fmc-adc-100m/Config.in
```kconfig
config BR2_PACKAGE_FMC_ADC_100M
	bool "fmc-adc-100m"
	select BR2_PACKAGE_ZIO
	help
	  FmcAdc100M14b4cha is a 4 channel 100MSPS 14 bit ADC low pin count
	  FPGA Mezzanine Card (VITA 57).

	  https://ohwr.org/project/fmc-adc-100m14b4cha
```

## package/fmc-sw/Config.in
```kconfig
config BR2_PACKAGE_FMC_SW
	bool "fmc-sw"
	help
	  This project aims to provide basic support to FMC modules with respect
	  to the VITA 57.1 standard.

	  https://ohwr.org/project/fmc-sw
```

## package/fpga-manager/Config.in
```kconfig
config BR2_PACKAGE_FPGA_MANAGER
	bool "fpga-manager"
	help
	  Backport of the FPGA manager provided by the Linux kernel

	  https://gitlab.cern.ch/coht/fpga-manager
```

## package/general-cores/Config.in
```kconfig
config BR2_PACKAGE_GENERAL_CORES
	bool "general-cores"
	help
	  A collection of platform-independent cores such as memories,
	  synchronizer circuits and Wishbone cores.

	  https://ohwr.org/project/general-cores
```

## package/gr-drm/Config.in
```kconfig
config BR2_PACKAGE_GR_DRM
	bool "gr-drm"
	depends on BR2_PACKAGE_FAAC
	depends on BR2_PACKAGE_GNURADIO
	select BR2_PACKAGE_GNURADIO_DIGITAL
	select BR2_PACKAGE_BOOST
	select BR2_PACKAGE_CPPUNIT
	help
	  GNU Radio DRM source
          
	  https://github.com/kit-cel/gr-drm
```

## package/gr-rpitx/Config.in
```kconfig
config BR2_PACKAGE_GR_RPITX
	bool "gr-rpitx"
	select BR2_PACKAGE_LIBRPITX 
	depends on BR2_PACKAGE_GNURADIO
	help
	  GNU Radio RPiTX sink
          
	  https://github.com/jmfriedt/gr-rpitx
```

## package/ht-flasher/Config.in
```kconfig
config BR2_PACKAGE_HT_FLASHER
	bool "ht-flasher"
	select BR2_PACKAGE_UAL
	help
	  Flasher for a variety of BE-CO-HT cards (SVEC, SPEC, CTRVD, CTRFMC)

	  https://gitlab.cern.ch/coht/ht-flasher
```

## package/libxtrxll/Config.in
```kconfig
config BR2_PACKAGE_LIBXTRXLL
	bool "libxtrxll"
	select BR2_LINUX_KERNEL_EXT_XTRX_LINUX_PCIE_DRV
	help
	  Low level XTRX hardware abstraction library

	  https://github.com/xtrx-sdr/libxtrxll
```

## package/litex/Config.in
```kconfig
config BR2_PACKAGE_LITEX
	bool "litex"

	depends on BR2_PACKAGE_PYTHON3
	select BR2_PACKAGE_MIGEN
	select BR2_PACKAGE_PYTHON_REQUESTS
	select BR2_PACKAGE_PYTHON_SERIAL
	select BR2_PACKAGE_PYTHONDATA_SOFTWARE_COMPILER_RT
	help
	  The LiteX framework provides a convenient and efficient
	  infrastructure to create FPGA Cores/SoCs, to explore various digital
	  design architectures and create full FPGA based systems.

	  https://github.com/enjoy-digital/litex/
```

## package/migen/Config.in
```kconfig
config BR2_PACKAGE_MIGEN
	bool "migen"

	depends on BR2_PACKAGE_PYTHON3
	select BR2_PACKAGE_PYTHON_COLORAMA
	help
	  A Python toolbox for building complex digital hardware

	  https://github.com/m-labs/migen
```

## package/mock-turtle/Config.in
```kconfig
config BR2_PACKAGE_MOCK_TURTLE
	bool
	help
	  Mock Turtle is an HDL core of a generic control system node,
	  based on a deterministic multicore CPU architecture.

	  https://ohwr.org/project/mock-turtle

comment "mock-turtle userspace needs host python3"
	depends on !BR2_PACKAGE_HOST_PYTHON3

comment "mock-turtle userspace needs python3"
	depends on !BR2_PACKAGE_PYTHON3

config BR2_PACKAGE_MOCK_TURTLE_USERSPACE
	bool "mock-turtle userspace"
	depends on BR2_PACKAGE_HOST_PYTHON3
	depends on BR2_PACKAGE_PYTHON3
	select BR2_LINUX_KERNEL_EXT_MOCK_TURTLE
	help
	  Mock Turtle is an HDL core of a generic control system node,
	  based on a deterministic multicore CPU architecture.

	  https://ohwr.org/project/mock-turtle
```

## package/pybind11/Config.in
```kconfig
comment "pybind11 needs a toolchain w/ C++, wchar"
	depends on !BR2_INSTALL_LIBSTDCPP || !BR2_USE_WCHAR

config BR2_PACKAGE_PYBIND11
	bool "pybind11"
	depends on BR2_USE_WCHAR # boost
	depends on BR2_INSTALL_LIBSTDCPP # boost
	depends on !BR2_TOOLCHAIN_HAS_GCC_BUG_64735 # boost-thread
	select BR2_PACKAGE_BOOST
	help
	  Pybind11 is a lightweight header-only library that exposes C++
	  types in Python and vice versa, mainly to create Python
	  bindings of existing C++ code.

	  http://pybind11.readthedocs.org/en/master

if BR2_PACKAGE_PYBIND11

config BR2_PACKAGE_PYBIND11_WITH_PYTHON
	bool "pybind11-python"
	depends on BR2_PACKAGE_PYTHON3
	help
	  Activate support for python-pybind

endif
```

## package/python-ad9546/Config.in
```kconfig
config BR2_PACKAGE_PYTHON_AD9546
	bool "python-ad9546"
	select BR2_PACKAGE_PYTHON_SMBUS_CFFI
	help
	  Python tools to manage AD9546/45 chipsets
	  https://github.com/gwbres/adi-ad9546
```

## package/python-ad9548/Config.in
```kconfig
config BR2_PACKAGE_PYTHON_AD9548
	bool "python-ad9548"
	select BR2_PACKAGE_PYTHON_SMBUS_CFFI
	help
	  Python tools to manage AD9548/47 chipsets
	  https://github.com/gwbres/adi-ad9548
```

## package/python-beniget/Config.in
```kconfig
config BR2_PACKAGE_PYTHON_BENIGET
	bool "python-beniget"
	help
	  Beniget is a collection of Compile-time analyse on Python
	  Abstract Syntax Tree(AST). It's a building block to write
	  static analyzer or compiler for Python.
```

## package/python-gast/Config.in
```kconfig
config BR2_PACKAGE_PYTHON_GAST
	bool "python-gast"
	help
	  A generic AST to represent Python2 and Python3
	  Abstract Syntax Tree (AST).
```

## package/python-joblib/Config.in
```kconfig
config BR2_PACKAGE_PYTHON_JOBLIB
	bool "python-joblib"
	depends on BR2_PACKAGE_PYTHON3
	help
	  Joblib is a set of tools to provide lightweight
	  pipelining in Python.

	  https://joblib.readthedocs.io/en/latest/
```
