## Config.in
```kconfig
menu "LiteX"
source "$BR2_EXTERNAL_OSCBR2EXTERNAL_PATH/package/litex/Config.in"
source "$BR2_EXTERNAL_OSCBR2EXTERNAL_PATH/package/migen/Config.in"
source "$BR2_EXTERNAL_OSCBR2EXTERNAL_PATH/package/pythondata-software-compiler_rt/Config.in"
endmenu
menu "WRTD"
comment "WRTD Packages"
source "$BR2_EXTERNAL_OSCBR2EXTERNAL_PATH/package/adc-lib/Config.in"
source "$BR2_EXTERNAL_OSCBR2EXTERNAL_PATH/package/fmc-adc-100m/Config.in"
source "$BR2_EXTERNAL_OSCBR2EXTERNAL_PATH/package/fmc-sw/Config.in"
source "$BR2_EXTERNAL_OSCBR2EXTERNAL_PATH/package/fpga-manager/Config.in"
source "$BR2_EXTERNAL_OSCBR2EXTERNAL_PATH/package/general-cores/Config.in"
source "$BR2_EXTERNAL_OSCBR2EXTERNAL_PATH/package/ht-flasher/Config.in"
source "$BR2_EXTERNAL_OSCBR2EXTERNAL_PATH/package/mock-turtle/Config.in"
source "$BR2_EXTERNAL_OSCBR2EXTERNAL_PATH/package/spec/Config.in"
source "$BR2_EXTERNAL_OSCBR2EXTERNAL_PATH/package/spec-binaries/Config.in"
source "$BR2_EXTERNAL_OSCBR2EXTERNAL_PATH/package/ual/Config.in"
source "$BR2_EXTERNAL_OSCBR2EXTERNAL_PATH/package/wrtd/Config.in"
source "$BR2_EXTERNAL_OSCBR2EXTERNAL_PATH/package/wrtd-binaries/Config.in"
source "$BR2_EXTERNAL_OSCBR2EXTERNAL_PATH/package/wrpc-sw/Config.in"
source "$BR2_EXTERNAL_OSCBR2EXTERNAL_PATH/package/zio/Config.in"
endmenu
source "$BR2_EXTERNAL_OSCBR2EXTERNAL_PATH/package/ad936x_ref_cal/Config.in"
source "$BR2_EXTERNAL_OSCBR2EXTERNAL_PATH/package/gnss-sdr/Config.in"
source "$BR2_EXTERNAL_OSCBR2EXTERNAL_PATH/package/libad9361-iio/Config.in"
source "$BR2_EXTERNAL_OSCBR2EXTERNAL_PATH/package/libiio-pluto/Config.in"
source "$BR2_EXTERNAL_OSCBR2EXTERNAL_PATH/package/libini/Config.in"
comment "XTRX Packages"
source "$BR2_EXTERNAL_OSCBR2EXTERNAL_PATH/linux/Config.ext.in"
source "$BR2_EXTERNAL_OSCBR2EXTERNAL_PATH/package/liblms7002m/Config.in"
source "$BR2_EXTERNAL_OSCBR2EXTERNAL_PATH/package/libusb3380/Config.in"
source "$BR2_EXTERNAL_OSCBR2EXTERNAL_PATH/package/libxtrx/Config.in"
source "$BR2_EXTERNAL_OSCBR2EXTERNAL_PATH/package/libxtrxll/Config.in"
source "$BR2_EXTERNAL_OSCBR2EXTERNAL_PATH/package/libxtrxdsp/Config.in"
source "$BR2_EXTERNAL_OSCBR2EXTERNAL_PATH/package/xtrx_linux_pcie_drv/Config.in"
comment "XTRX Packages end"
source "$BR2_EXTERNAL_OSCBR2EXTERNAL_PATH/package/pluto-system-top-bit/Config.in"
source "$BR2_EXTERNAL_OSCBR2EXTERNAL_PATH/package/poll_sysfs/Config.in"
source "$BR2_EXTERNAL_OSCBR2EXTERNAL_PATH/package/gr-iio/Config.in"
source "$BR2_EXTERNAL_OSCBR2EXTERNAL_PATH/package/vxi11/Config.in"
source "$BR2_EXTERNAL_OSCBR2EXTERNAL_PATH/package/librpitx/Config.in"
source "$BR2_EXTERNAL_OSCBR2EXTERNAL_PATH/package/rpitx/Config.in"
source "$BR2_EXTERNAL_OSCBR2EXTERNAL_PATH/package/ft8_lib/Config.in"
source "$BR2_EXTERNAL_OSCBR2EXTERNAL_PATH/package/gr-rpitx/Config.in"
source "$BR2_EXTERNAL_OSCBR2EXTERNAL_PATH/package/gr-drm/Config.in"
comment "Scikit-learn packages"
source "$BR2_EXTERNAL_OSCBR2EXTERNAL_PATH/package/python-joblib/Config.in"
source "$BR2_EXTERNAL_OSCBR2EXTERNAL_PATH/package/python-threadpoolctl/Config.in"
source "$BR2_EXTERNAL_OSCBR2EXTERNAL_PATH/package/python-scikitlearn/Config.in"
comment "Scikit-learn packages end"
source "$BR2_EXTERNAL_OSCBR2EXTERNAL_PATH/package/python3-pygccxml/Config.in"
source "$BR2_EXTERNAL_OSCBR2EXTERNAL_PATH/package/faac/Config.in"
comment "Analog Devices packages"
source "$BR2_EXTERNAL_OSCBR2EXTERNAL_PATH/package/python-ad9546/Config.in"
source "$BR2_EXTERNAL_OSCBR2EXTERNAL_PATH/package/python-ad9548/Config.in"
comment "Analog Devices end"
```
