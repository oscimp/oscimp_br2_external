## package/python-pyext/Config.in
```kconfig
config BR2_PACKAGE_PYTHON_PYEXT
	bool "python-pyext"
	help
	  python-pyext is a set of extensions to enhance python.
	  This includes features such as function overloading,
	  the 'switch' statement, python2 safe tuple unpacking..
	  
	  https://pypi.org/project/pyext/ 
```

## package/python-pythran/Config.in
```kconfig
config BR2_PACKAGE_PYTHON_PYTHRAN
	bool "python-pythran"
	depends on BR2_PACKAGE_PYTHON_NUMPY_ARCH_SUPPORTS # python-numpy
	depends on BR2_TOOLCHAIN_USES_GLIBC || BR2_TOOLCHAIN_USES_MUSL # python-numpy
	select BR2_PACKAGE_PYTHON_NUMPY # runtime
	help
	  Pythran s an ahead of time compiler for a subset of the Python language, 
      with a focus on scientific computing. 
```

## package/python-scikitlearn/Config.in
```kconfig
config BR2_PACKAGE_PYTHON_SCIKITLEARN
	bool "python-scikitlearn"
	depends on BR2_TOOLCHAIN_HAS_FORTRAN # python-scipy
	depends on BR2_PACKAGE_OPENBLAS_ARCH_SUPPORTS # python-scipy
	depends on BR2_PACKAGE_PYTHON_NUMPY_ARCH_SUPPORTS # python-numpy
	depends on BR2_TOOLCHAIN_USES_GLIBC || BR2_TOOLCHAIN_USES_MUSL # python-numpy
	select BR2_PACKAGE_PYTHON_NUMPY
	select BR2_PACKAGE_PYTHON_SCIPY
	select BR2_PACKAGE_PYTHON_JOBLIB
	select BR2_PACKAGE_PYTHON_THREADPOOLCTL
	help
	  Scikit-Learn is a Python module for machine learning
	  built on top of Python-Scipy.
	  https://scikit-learn.org/

comment "python-scikitlearn needs a toolchain with fortran"
	  depends on !BR2_TOOLCHAIN_HAS_FORTRAN

comment "python-scikitlearn needs lib openblas"
	  depends on !BR2_PACKAGE_OPENBLAS_ARCH_SUPPORTS

comment "python-scikitlearn needs python-numpy"
	depends on !BR2_PACKAGE_PYTHON_NUMPY_ARCH_SUPPORTS
```

## package/python-scipy/Config.in
```kconfig
comment "python-scipy needs a toolchain w/ C++, wchar"
	depends on !BR2_INSTALL_LIBSTDCPP || !BR2_USE_WCHAR

comment "python-scipy needs a toolchain w/ fortran"
	depends on BR2_PACKAGE_LAPACK_ARCH_SUPPORTS
	depends on !BR2_TOOLCHAIN_HAS_FORTRAN

comment "python-scipy needs lib openblas or lapack"
	  depends on !BR2_PACKAGE_OPENBLAS_ARCH_SUPPORTS && !BR2_PACKAGE_LAPACK_ARCH_SUPPORTS

comment "python-scipy needs glibc or musl"
	depends on BR2_PACKAGE_PYTHON3
	depends on BR2_PACKAGE_PYTHON_NUMPY_ARCH_SUPPORTS
	depends on !(BR2_TOOLCHAIN_USES_GLIBC || BR2_TOOLCHAIN_USES_MUSL)

config BR2_PACKAGE_PYTHON_SCIPY
	bool "python-scipy"
	depends on BR2_PACKAGE_PYTHON3
	depends on BR2_PACKAGE_PYTHON_NUMPY_ARCH_SUPPORTS # python-numpy
	depends on BR2_PACKAGE_OPENBLAS_ARCH_SUPPORTS || \
		(BR2_PACKAGE_LAPACK_ARCH_SUPPORTS && BR2_TOOLCHAIN_HAS_FORTRAN)
	depends on BR2_TOOLCHAIN_USES_GLIBC || BR2_TOOLCHAIN_USES_MUSL # python-numpy
	select BR2_PACKAGE_PYTHON_NUMPY # runtime
	select BR2_PACKAGE_PYTHON_PYBIND
	select BR2_PACKAGE_PYTHON_PYTHRAN
	select BR2_PACKAGE_PYTHON_BENIGET
	select BR2_PACKAGE_PYTHON_GAST
	select BR2_PACKAGE_PYTHON_PLY
	select BR2_PACKAGE_BOOST
	select BR2_PACKAGE_BOOST_PYTHON
	help
	  Scipy is a Python package that includes modules for
	  statistics, optimization, linear algebra and much
	  more.

	  http://www.scipy.org/

if BR2_PACKAGE_PYTHON_SCIPY

choice
	prompt "BLAS implementation"

config BR2_PACKAGE_PYTHON_SCIPY_OPENBLAS
	bool "openblas"
	depends on BR2_PACKAGE_OPENBLAS_ARCH_SUPPORTS
	select BR2_PACKAGE_OPENBLAS

config BR2_PACKAGE_PYTHON_SCIPY_LAPACK
	bool "lapack"
	depends on BR2_PACKAGE_LAPACK_ARCH_SUPPORTS
	select BR2_PACKAGE_LAPACK

endchoice
endif
```

## package/python-threadpoolctl/Config.in
```kconfig
config BR2_PACKAGE_PYTHON_THREADPOOLCTL
	bool "python-threadpoolctl"
	depends on BR2_PACKAGE_PYTHON3
	help
	  Python helpers to limit the number of threads
	  used in the threadpool-backed of common native
	  libraries used for scientific computing and
	  data science (e.g. BLAS and OpenMP).

	  https://github.com/joblib/threadpoolctl
```

## package/python3-pygccxml/Config.in
```kconfig
config BR2_PACKAGE_PYTHON3_PYGCCXML
	bool "python3-pygccxml"
	depends on BR2_PACKAGE_PYTHON3
	help
	  Python3 module for pygccxml.

	  https://github.com/CastXML/pygccxml
```

## package/pythondata-software-compiler_rt/Config.in
```kconfig
config BR2_PACKAGE_PYTHONDATA_SOFTWARE_COMPILER_RT
	bool "pythondata-software-compiler_rt"

	depends on BR2_PACKAGE_PYTHON3
	help
	  Non-Python  files needed for the software compiler_rt packaged
	  into a Python module so they can be used with Python libraries and tools.

	  https://github.com/litex-hub/pythondata-software-compiler_rt/
```

## package/spec-binaries/Config.in
```kconfig
config BR2_PACKAGE_SPEC_BINARIES
	bool "spec-binaries"
	help
	  A simple 4-lane PCIe carrier for a low pin count FPGA Mezzanine Card (VITA 57).

	  https://ohwr.org/project/spec
```

## package/spec/Config.in
```kconfig
config BR2_PACKAGE_SPEC
	bool "spec"
	select BR2_PACKAGE_FMC_SW
	select BR2_PACKAGE_FPGA_MANAGER
	select BR2_PACKAGE_GENERAL_CORES
	help
	  A simple 4-lane PCIe carrier for a low pin count FPGA Mezzanine Card (VITA 57).

	  https://ohwr.org/project/spec
```

## package/ual/Config.in
```kconfig
config BR2_PACKAGE_UAL
	bool "ual"
	help
	  The Universal Access Librasy (also known as UAL) is a userspace
	  library whose aim is to make transparent the acess to physical
	  busses.

	  https://gitlab.cern.ch/cohtdrivers/ual
```

## package/wishbone-gen/Config.in.host
```kconfig
comment "wishbone-gen needs lua 5.1"
	depends on !BR2_PACKAGE_LUA_5_1

config BR2_PACKAGE_HOST_WISHBONE_GEN
	bool "host wishbone-gen"
	depends on BR2_PACKAGE_LUA_5_1
	help
	  wbgen2 is a tool for generating VHDL/Verilog cores which
	  implement Wishbone bus slaves with certain registers,
	  memory blocks, FIFOs and interrupts.

	  https://ohwr.org/project/wishbone-gen
```

## package/wrpc-sw/Config.in
```kconfig
config BR2_PACKAGE_WRPC_SW
	bool "wrpc-sw"
	select BR2_PACKAGE_READLINE
	help
	  White Rabbit Trigger Distribution (WRTD) is a generic
	  framework  for distributing triggers (events) between
	  Nodes over a White Rabbit network.

	  https://ohwr.org/project/wrtd
```

## package/wrtd-binaries/Config.in
```kconfig
config BR2_PACKAGE_WRTD_BINARIES
	bool "wrtd-binaries"
	help
	  White Rabbit Trigger Distribution (WRTD) is a generic
	  framework  for distributing triggers (events) between
	  Nodes over a White Rabbit network.

	  https://ohwr.org/project/wrtd
```

## package/wrtd/Config.in
```kconfig
config BR2_PACKAGE_WRTD
	bool
	select BR2_PACKAGE_MOCK_TURTLE
	help
	  White Rabbit Trigger Distribution (WRTD) is a generic
	  framework  for distributing triggers (events) between
	  Nodes over a White Rabbit network.

	  https://ohwr.org/project/wrtd

comment "wrtd userspace needs host python3"
	depends on !BR2_PACKAGE_HOST_PYTHON3

comment "wrtd userspace needs python3"
	depends on !BR2_PACKAGE_PYTHON3

config BR2_PACKAGE_WRTD_USERSPACE
	bool "wrtd userspace"
	depends on BR2_PACKAGE_HOST_PYTHON3
	depends on BR2_PACKAGE_PYTHON3
	select BR2_LINUX_KERNEL_EXT_WRTD
	select BR2_PACKAGE_MOCK_TURTLE_USERSPACE
	select BR2_PACKAGE_PYTHON_DECORATOR
	select BR2_PACKAGE_PYTHON_SETUPTOOLS
	select BR2_PACKAGE_PYTHON3_PYEXPAT
	select BR2_PACKAGE_PYTHON_PYYAML
	help
	  White Rabbit Trigger Distribution (WRTD) is a generic
	  framework  for distributing triggers (events) between
	  Nodes over a White Rabbit network.

	  https://ohwr.org/project/wrtd
```

## package/zio/Config.in
```kconfig
config BR2_PACKAGE_ZIO
	bool
	help
	  A software framework for Linux device drivers aimed at
	  supporting controls and data acquisition hardware.

	  https://ohwr.org/project/zio

config BR2_PACKAGE_ZIO_USERSPACE
	bool "zio userspace"
	select BR2_LINUX_KERNEL_EXT_ZIO
	help
	  A software framework for Linux device drivers aimed at
	  supporting controls and data acquisition hardware.

	  https://ohwr.org/project/zio
```
