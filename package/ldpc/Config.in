## package/ldpc/Config.in
```kconfig
config BR2_PACKAGE_LDPC
	bool "ldpc-codes"
	help
	  PocketSDR dependency: ldpc-codes
```

## package/libmetal/Config.in
```kconfig
config BR2_PACKAGE_LIBMETAL
	bool "libmetal"
        select BR2_PACKAGE_LIBSYSFS
	help
	  Libmetal
```

## package/openamp/Config.in
```kconfig
config BR2_PACKAGE_OPENAMP
	bool "openamp"
        select BR2_PACKAGE_GNUTLS
	help
	  OpenAMP
```

## package/pocketsdr/Config.in
```kconfig
config BR2_PACKAGE_POCKETSDR
	bool "PocketSDR"
        select BR2_PACKAGE_LIBFEC
        select BR2_PACKAGE_LDPC
        select BR2_PACKAGE_LIBUSB
        select BR2_PACKAGE_FFTW
	help
	  PocketSDR libraries, configuration and acquisition
```
